## layer/meta-rapid/conf/distro/rapid-os.conf
```bitbake
DISTRO = "rapid-os"
DISTRO_NAME = "Rapid OS"
DISTRO_VERSION = "0.1.0"

TCLIBC = "glibc"

SANITY_TESTED_DISTROS ?= " \
            ubuntu-24.04 \n \
"

DISTRO_FEATURES:append = " bluez5 bluetooth wifi"

INIT_MANAGER = "systemd"
```

## layer/meta-rapid/conf/layer.conf
```bitbake
BBPATH .= ":${LAYERDIR}"

BBFILES += "${LAYERDIR}/recipes-*/*/*.bb \
            ${LAYERDIR}/recipes-*/*/*.bbappend"

BBFILE_COLLECTIONS += "rapid"
BBFILE_PATTERN_rapid = "^${LAYERDIR}/"
BBFILE_PRIORITY_rapid = "5"
LAYERVERSION_rapid = "4"
LAYERSERIES_COMPAT_rapid = "styhead"
```
